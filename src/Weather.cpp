#include "Weather.hpp"
#include "parson.h"

// 0
static const uint8_t icon_clear_day[] PROGMEM = {
	0x00, 0x00, 0x00, 0x00, 0x00, 0x00, 
	0x00, 0x00, 0x00, 0x00, 0x00, 0x00, 
	0x00, 0x00, 0x00, 0x00, 0x00, 0x00, 
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	0x00, 0x00, 0x00, 0x00, 0x00, 0x00};
// 1
static const uint8_t icon_clear_night[] PROGMEM = {
	0x00, 0x00, 0x00, 0x00, 0x00, 0x00, 
	0x00, 0x00, 0x00, 0x00, 0x00, 0x00, 
	0x00, 0x00, 0x00, 0x00, 0x00, 0x00, 
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	0x00, 0x00, 0x00, 0x00, 0x00, 0x00};
// 2
static const uint8_t icon_partly_cloudy_day[] PROGMEM = {
	0x00, 0x00, 0x00, 0x00, 0x00, 0x00, 
	0x00, 0x00, 0x00, 0x00, 0x00, 0x00, 
	0x00, 0x00, 0x00, 0x00, 0x00, 0x00, 
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	0x00, 0x00, 0x00, 0x00, 0x00, 0x00};
// 3
static const uint8_t icon_partly_cloudy_night[] PROGMEM = {
	0x00, 0x00, 0x00, 0x00, 0x00, 0x00, 
	0x00, 0x00, 0x00, 0x00, 0x00, 0x00, 
	0x00, 0x00, 0x00, 0x00, 0x00, 0x00, 
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	0x00, 0x00, 0x00, 0x00, 0x00, 0x00};
// 4
static const uint8_t icon_scattered_day[] PROGMEM = {
	0x00, 0x00, 0x00, 0x00, 0x00, 0x00, 
	0x00, 0x00, 0x00, 0x00, 0x00, 0x00, 
	0x00, 0x00, 0x00, 0x00, 0x00, 0x00, 
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	0x00, 0x00, 0x00, 0x00, 0x00, 0x00
};
// 5
static const uint8_t icon_scattered_night[] PROGMEM = {
	0x00, 0x00, 0x00, 0x00, 0x00, 0x00, 
	0x00, 0x00, 0x00, 0x00, 0x00, 0x00, 
	0x00, 0x02, 0x00, 0x00, 0x00, 0x00, 
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	0x00, 0x00, 0x00, 0x00, 0x00, 0x00};
// 6
static const uint8_t icon_cloudy_day[] PROGMEM = {
	0x00, 0x00, 0x00, 0x00, 0x00, 0x00, 
	0x00, 0x00, 0x00, 0x00, 0x00, 0x00, 
	0x00, 0x00, 0x00, 0x00, 0x00, 0x00, 
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	0x00, 0x00, 0x00, 0x00, 0x00, 0x00};
// 7
static const uint8_t icon_cloudy_night[] PROGMEM = {
	0x00, 0x00, 0x00, 0x00, 0x00, 0x00, 
	0x00, 0x00, 0x00, 0x00, 0x00, 0x00, 
	0x00, 0x00, 0x00, 0x00, 0x00, 0x00, 
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	0x00, 0x00, 0x00, 0x00, 0x00, 0x00};
// 8
static const uint8_t icon_rain[] PROGMEM = {
	0x00, 0x00, 0x00, 0x00, 0x00, 0x00, 
	0x00, 0x00, 0x00, 0x00, 0x00, 0x00, 
	0x00, 0x00, 0x00, 0x00, 0x00, 0x00, 
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	0x00, 0x00, 0x00, 0x00, 0x00, 0x00};
// 9
static const uint8_t icon_partialy_rain_day[] PROGMEM = {
	0x00, 0x00, 0x00, 0x00, 0x00, 0x00, 
	0x00, 0x00, 0x00, 0x00, 0x00, 0x00, 
	0x00, 0x01, 0x80, 0x00, 0x00, 0x00, 
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	0x00, 0x00, 0x00, 0x00, 0x00, 0x00};
// 10
static const uint8_t icon_partialy_rain_night[] PROGMEM = {
	0x00, 0x00, 0x00, 0x00, 0x00, 0x00, 
	0x00, 0x1f, 0xc0, 0x00, 0x00, 0x00, 
	0x00, 0x1f, 0xf8, 0x00, 0x00, 0x00, 
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	0x00, 0x00, 0x00, 0x00, 0x00, 0x00
};
// 11
static const uint8_t icon_thunderstorm[] PROGMEM = {
	0x00, 0x00, 0x00, 0x00, 0x00, 0x00,
	0x00, 0x00, 0x00, 0x00, 0x00, 0x00,
	0x00, 0x00, 0x00, 0x00, 0x00, 0x00,
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	0x00, 0x00, 0x00, 0x00, 0x00, 0x00};
// 12
static const uint8_t icon_snow[] PROGMEM = {
	0x00, 0x00, 0x00, 0x00, 0x00, 0x00,
	0x00, 0x00, 0x00, 0x00, 0x00, 0x00,
	0x00, 0x00, 0x00, 0x00, 0x00, 0x00,
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	0x00, 0x00, 0x00, 0x00, 0x00, 0x00};
// 13
static const uint8_t icon_fog_day[] PROGMEM = {
	0x00, 0x00, 0x00, 0x00, 0x00, 0x00,
	0x00, 0x00, 0x00, 0x00, 0x00, 0x00,
	0x00, 0x00, 0x00, 0x00, 0x00, 0x00,
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	0x00, 0x00, 0x00, 0x00, 0x00, 0x00};
// 14
static const uint8_t icon_fog_night[] PROGMEM = {
	0x00, 0x00, 0x00, 0x00, 0x00, 0x00, 
	0x00, 0x00, 0x00, 0x00, 0x00, 0x00, 
	0x00, 0x00, 0x00, 0x00, 0x00, 0x00, 
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	0x00, 0x00, 0x00, 0x00, 0x00, 0x00};
// 15
static const uint8_t icon_sleet[] PROGMEM = {
	0x00, 0x00, 0x00, 0x00, 0x00, 0x00,
	0x00, 0x00, 0x00, 0x00, 0x00, 0x00,
	0x00, 0x00, 0x00, 0x00, 0x00, 0x00,
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	0x00, 0x00, 0x00, 0x00, 0x00, 0x00};
// 16
static const uint8_t icon_wind[] PROGMEM = {
	0x00, 0x00, 0x00, 0x00, 0x00, 0x00,
	0x00, 0x00, 0x00, 0x00, 0x00, 0x00,
	0x00, 0x00, 0x00, 0x00, 0x00, 0x00,
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	0x00, 0x00, 0x00, 0x00, 0x00, 0x00};

enum weather_icons
{
	CLEAR_DAY, // 0
	CLEAR_NIGHT, // 1
	PARTLY_CLOUDY_DAY, // 2
	PARTLY_CLOUDY_NIGHT, // 3
	SCATTERTED_DAY, // 4
	SCATTERTED_NIGHT, // 5
	CLOUDY, // 6
	CLOUDY_NIGHT, // 7
	RAIN, // 8
	PARTLY_RAIN_DAY, // 9
	PARTLY_RAIN_NIGHT, // 10
	THUNDERSTORM, // 11
	SNOW, // 12
	FOG, // 13
	FOG_NIGHT, // 14
	SLEET, //15
	WIND // 16
};

Weather::Weather()
{
	for (int hr = 0; hr < FORECAST_HOURS; hr++)
	{
		weather_data_t *wd = new weather_data_t{
			this->get_icon(hr % 12),
			int8_t(50 + hr),
			int8_t(45 + 0.2 * hr),
			0};

		hourly_data[hr] = wd;
	}

	for (int day = 0; day < FORECAST_DAYS; day++)
	{
		forecast_data[day] = new weather_data_t{
			hourly_data[day]->icon,
			hourly_data[day]->high,
			hourly_data[day]->low,
			};
		forecast_data[day]->day = day;
	}

	current_weather = hourly_data[0];
	current_day = -1;
}

Weather::~Weather()
{

}

bool Weather::is_new_day(int day)
{
	return current_day != day;
}

const uint8_t* Weather::get_icon(int icon)
{
	switch (icon)
	{
	case CLEAR_DAY:
		return icon_clear_day;
	case CLEAR_NIGHT:
		return icon_clear_night;
	case PARTLY_CLOUDY_DAY:
		return icon_partly_cloudy_day;
	case PARTLY_CLOUDY_NIGHT:
		return icon_partly_cloudy_night;
	case SCATTERTED_DAY:
		return icon_scattered_day;
	case SCATTERTED_NIGHT:
		return icon_scattered_night;
	case CLOUDY:
		return icon_cloudy_day;
	case CLOUDY_NIGHT:
		return icon_cloudy_night;
	case RAIN:
		return icon_rain;
	case PARTLY_RAIN_DAY:
		return icon_partialy_rain_day;
	case PARTLY_RAIN_NIGHT:
		return icon_partialy_rain_night;
	case THUNDERSTORM:
		return icon_thunderstorm;
	case SNOW:
		return icon_snow;
	case FOG:
		return icon_fog_day;
	case FOG_NIGHT:
		return icon_fog_night;
	case SLEET:
		return icon_sleet;
	case WIND:
		return icon_wind;
	default:
		return icon_clear_day;
	}
}

void Weather::get_weather(Messenger& messenger, int today)
{
	char buffer[1024];

	int result = messenger.get_request(URL_GET_FORECAST, buffer, 1024);
	current_day = today; // if the request failed, still update so thermostat doesn't ask for updates every minute.
	if (result < 1) {
		// request failed
		return;
	}
	
	JSON_Value* raw = json_parse_string(buffer);
	JSON_Object* obj = json_value_get_object(raw);
	JSON_Array* hourly_array = json_object_get_array(obj, "hourly");
	int hours = min(json_array_get_count(hourly_array), FORECAST_HOURS);

	for (int i=0; i < hours; i++) {
		JSON_Object* hour_obj = json_array_get_object(hourly_array, i);
		int icon = (int)json_object_get_number(hour_obj, "i");
		int temp = (int)json_object_get_number(hour_obj, "t");
		hourly_data[i]->icon = get_icon(icon);
		hourly_data[i]->high = temp;
	}

	JSON_Array* daily_array = json_object_get_array(obj, "daily");
	int days = min(json_array_get_count(daily_array), FORECAST_DAYS);
	for (int i=0; i < days; i++) {
		JSON_Object* daily_obj = json_array_get_object(daily_array, i);
		int day = (int)json_object_get_number(daily_obj, "d");
		int icon = (int)json_object_get_number(daily_obj, "i");
		int tH = (int)json_object_get_number(daily_obj, "H");
		int tL = (int)json_object_get_number(daily_obj, "L");
		forecast_data[i]->day = day;
		forecast_data[i]->icon = get_icon(icon);
		forecast_data[i]->high = tH;
		forecast_data[i]->low = tL;
	}
	json_value_free(raw);
}

void Weather::set_current_weather(int hr)
{
	if (hr >= 0 && hr <= 24)
	{
		current_weather = hourly_data[hr];
	}
}

weather_data_t* Weather::get_current_weather()
{
	return current_weather;
}

weather_data_t* Weather::get_forecast(int day)
{
	day--;
	if (day >= 0 && day <= 2)
	{
		return forecast_data[day];
	}
	else
	{
		return forecast_data[0];
	}
}
